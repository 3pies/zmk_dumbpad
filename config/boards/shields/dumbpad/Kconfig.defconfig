## config/boards/shields/dumbpad/Kconfig.defconfig
```kconfig
# Copyright (c) 2023 Daniel Ferrer
# SPDX-License-Identifier: MIT

if SHIELD_DUMBPAD

config ZMK_KEYBOARD_NAME
    default "Dumbpad"

endif
```

## config/boards/shields/dumbpad/Kconfig.shield
```kconfig
# Copyright (c) 2023 Daniel Ferrer
# SPDX-License-Identifier: MIT

config SHIELD_DUMBPAD
    def_bool $(shields_list_contains,dumbpad)
```
